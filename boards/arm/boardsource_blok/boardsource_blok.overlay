#include <dt-bindings/led/led.h>

&spi0 {
    compatible = "raspberrypi,pico-spi", "arm,pl022";
    status = "okay";
    pinctrl-0 = <&spi0_default>;
    pinctrl-names = "default";
    cs-gpios = <&gpio0 17 GPIO_ACTIVE_LOW>;

    led_strip: ws2812@0 {
        compatible = "worldsemi,ws2812-spi";
        
        reg = <0>;
        spi-max-frequency = <4000000>;
        
        /* WS2812 */
        chain-length = <11>;    /* number of LEDs */
        spi-one-frame = <0x70>;
        spi-zero-frame = <0x40>;
        
        color-mapping = <LED_COLOR_ID_GREEN 
                        LED_COLOR_ID_RED 
                        LED_COLOR_ID_BLUE>;
    };
};

/ {
    chosen {
        zmk,underglow = &led_strip;
    };
};