## boards/arm/boardsource_blok/boardsource_blok_defconfig
```kconfig
CONFIG_SOC_SERIES_RP2XXX=y
CONFIG_SOC_RP2040=y
CONFIG_BOARD_BOARDSOURCE_BLOK=y

CONFIG_SYS_CLOCK_HW_CYCLES_PER_SEC=125000000

# Enable GPIO
CONFIG_GPIO=y

# Enable SPI
CONFIG_SPI=y

# Enable WS2812 RGB LED support
CONFIG_ZMK_RGB_UNDERGLOW=y
CONFIG_WS2812_STRIP=y

# Enable USB
CONFIG_USB_DEVICE_STACK=y
CONFIG_USB_DEVICE_MANUFACTURER="Boardsource"
CONFIG_USB_DEVICE_PRODUCT="Blok"
CONFIG_USB_DEVICE_VID=0x2E8A
CONFIG_USB_DEVICE_PID=0x0000

# Code partition needed to work with MCUboot
CONFIG_USE_DT_CODE_PARTITION=y
```
